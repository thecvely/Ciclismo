## main/Kconfig.projbuild
```kconfig
menu "Dispositivo"

    menu "I2C"
    config I2C_SCL
        int "SCL GPIO Num"
        default 22
        help
            GPIO number for I2C Master clock line.

    config I2C_SDA
        int "SDA GPIO Num"
        default 21
        help
            GPIO number for I2C Master data line.

    config I2C_PORT
        int "Puerto I2C"
        range 0 1
        default 0
        help
            Puerto I2C del ESP32

    endmenu

    menu "Wifi"

        menu "Punto de Acceso"

            config AP_SSID
                string "WiFi SSID"
                default "myssid"
                help
                    SSID (network name) for the example to connect to.
        
            config AP_PASSWORD
                string "WiFi Password"
                default "mypassword"
                help
                    WiFi password (WPA or WPA2) for the example to use.
            config AP_CHANNEL
                int "WiFi Channel"
                range 1 13
                default 1
                help
                    WiFi channel (network channel) for the example to use.
        
            config AP_MAX_STA_CONN
                int "Maximal STA connections"
                default 4
                help
                    Max number of the STA connects to AP.
        endmenu
        
        
        menu "Estación"
        
            config STA_SSID
                string "WiFi SSID"
                default "myssid"
                help
                    SSID (network name) for the example to connect to.
        
            config STA_PASSWORD
                string "WiFi Password"
                default "mypassword"
                help
                    WiFi password (WPA or WPA2) for the example to use.
        
            config STA_MAXIMUM_RETRY
                int "Maximum retry"
                default 5
                help
                    Set the Maximum retry to avoid station reconnecting to the AP unlimited when the AP is really inexistent.
        endmenu


    endmenu

    menu "Sockets"
        config PORT_SOCKET_SERVER
            int "Port"
            range 0 65535
            default 7000
            help
                The remote port to which the client example will connect to.

    endmenu

    menu "MQTT"

        config BROKER_URI
            string "Broker URL"
            default "mqtts://mqtt.eclipse.org:8883"
            help
                URL of an mqtt broker which this example connects to.
    
        config BROKER_BIN_SIZE_TO_SEND
            # This option is not visible and is used only to set parameters for example tests
            # Here we configure the data size to send and to be expected in the python script
            int
            default 20000
    
    endmenu
    

endmenu
```
